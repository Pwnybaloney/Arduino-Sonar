/*

*/
#include <Wire.h>

const int numReadings = 4;

int readings[numReadings];      // the readings from the analog input
int readIndex = 0;              // the index of the current reading
int total = 0;                  // the running total
int average = 0;                // the average
int reading = 0; //distance

#include <Servo.h> 

boolean ledState = LOW;
int ledPin = 2;
Servo myservo;
int servopin = 9;

char recievedData;
String sentData;



int maxDataPoint = 90000;
float simulatedDistance = 5;
float simulatedAngleIncrement = 0.5;
float minAngle = 0.0;
float maxAngle = 180.;

float simulatedAngle = minAngle;
int dataPoint = 0;
 
long duration;
float distance;
int trigPin = 10;
int echoPin = 11;


void setup() {
  Wire.begin();                // join i2c bus (address optional for master)
  Serial.begin(9600); //start serial communication 
  standby();
  pinMode(ledPin,OUTPUT);
  myservo.attach(9);
  pinMode(trigPin,OUTPUT);
  pinMode(echoPin,INPUT);
  
}

void loop() {
  if (Serial.read() > 0){ //see if processing sent data
    recievedData = Serial.read(); //store the data sent by processing
    createInputStream();
    myservo.write(simulatedAngle);
    //Serial.println(dataPoint);
    Serial.println(sentData);
    //delay(20);
    /* send a pulse and count the microseconds it takes to get back" */
    digitalWrite(trigPin,LOW);
    delayMicroseconds(2);
    digitalWrite(trigPin,HIGH);
    delayMicroseconds(10);
    digitalWrite(trigPin,LOW);
    
    duration = pulseIn(echoPin,HIGH);
  
    //calculate time based on the duration it took for sound to travel
    distance = duration*0.034/2; //0.034 cm/microsecond /2 for double distance  


    //Serial.println(dataPoint);
    
    
    
  }
  //Stream.flush();
}


void standby(){
  while (Serial.available() <=0 ){
    
    Serial.println("Arduino Ready"); //send a specific message to indicate the arduino is ready
    delay(300); //more delay more stable
    
  }

}

void createInputStream(){ //create data in form "angle,distance/n"

  //for (int dataPoint = 0; dataPoint < maxDataPoint; dataPoint++){
  
  if (dataPoint < maxDataPoint){
    simulatedAngle = simulatedAngleIncrement + simulatedAngle;  //increment the angle
    
    if (simulatedAngle > maxAngle || simulatedAngle < minAngle){ //bounds of simulated data
      simulatedAngleIncrement = -simulatedAngleIncrement; //change the direction of the sweeper when it reaches the end
    }
    
      



  
    
    
    sentData = (String(simulatedAngle,3)+","+String(distance)+"\n");
  
  }
  
}