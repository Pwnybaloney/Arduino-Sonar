/*

*/
boolean ledState = LOW;
int ledPin = 2;

char recievedData;
String sentData;

  int maxDataPoint = 90000;
  float simulatedDistance = 5;
  float simulatedAngleIncrement = 0.5;
  float minAngle = 20.0;
  float maxAngle = 160.;
  float simulatedAngle = minAngle;
  int dataPoint = 0;

void setup() {
  Serial.begin(9600); //start serial communication 
  standby();
  pinMode(ledPin,OUTPUT);
  
}

void loop() {
  createInputStream();
  if (Serial.read() > 0){ //see if processing sent data
    recievedData = Serial.read(); //store the data sent by processing
    Serial.println(dataPoint);
    Serial.println(sentData);
    delay(100);
    


    //Serial.println(dataPoint);
    
    
    
  }
  //Stream.flush();
}


void standby(){
  while (Serial.available() <=0 ){
    Serial.println("Arduino Ready"); //send a specific message to indicate the arduino is ready
    delay(300); //more delay more stable
    
  }

}

void createInputStream(){ //create data in form "angle,distance/n"

  
  //for (int dataPoint = 0; dataPoint < maxDataPoint; dataPoint++){
    
  
  if (dataPoint < maxDataPoint){
    simulatedAngle = simulatedAngleIncrement + simulatedAngle;  //increment the angle
    
    if (simulatedAngle > maxAngle || simulatedAngle < minAngle){ //bounds of simulated data
      simulatedAngleIncrement = -simulatedAngleIncrement; //change the direction of the sweeper when it reaches the end
    }
  
    //adjust at what angle do you want what distance to be
    
    if (simulatedAngle > 60 && simulatedAngle < 100 ){ //simulate object detection
      simulatedDistance = 3;
    } else if (simulatedAngle >= 100 && simulatedAngle < 120){
      simulatedDistance = 4;
    } else {
      simulatedDistance = 5;
    }
    
    //simulatedDistance = 5;
    //Serial.println("\n");
    sentData = (String(simulatedAngle,3)+","+String(simulatedDistance,3)+"\n");
    //Serial.println(data);
    //Serial.println(dataPoint);
    //dataPoint++;
    ledState = !ledState;
    digitalWrite(ledPin, ledState);
    dataPoint++;
}
  //Serial.println(inputStreamList);
}